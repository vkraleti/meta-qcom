## conf/machine/iq10-rrd.conf
```bitbake
#@TYPE: Machine
#@NAME: Qualcomm IQ10-RRD based on Nord
#@DESCRIPTION: Machine configuration for Qualcomm IQ10-RRD, with Nord

require conf/machine/include/qcom-nord.inc

MACHINE_FEATURES += "efi pci"

# TODO: replace with the real DTB name(s) for iq10-rrd once available
KERNEL_DEVICETREE ?= " \
    qcom/iq10-rrd.dtb \
    qcom/sa8797p-ride.dtb \
    "

#MACHINE_ESSENTIAL_EXTRA_RRECOMMENDS += " \
#    packagegroup-iq10-rrd-firmware \
#    packagegroup-iq10-rrd-hexagon-dsp-binaries \
#"

# TODO: replace with the real CDT file name for iq10-rrd
QCOM_CDT_FILE = "cdt_iq10_rrd"
QCOM_BOOT_FILES_SUBDIR = "iq10-rrd/ufs"
QCOM_PARTITION_FILES_SUBDIR ?= "partitions/iq10-rrd/ufs"

QCOM_BOOT_FIRMWARE = "firmware-qcom-boot-nord"
QCOM_CDT_FIRMWARE = "firmware-qcom-cdt-nord"
```

## conf/machine/iq-10-rrd.conf
```bitbake
#@TYPE: Machine
#@NAME: Qualcomm IQ10-RRD based on Nord
#@DESCRIPTION: Machine configuration for Qualcomm IQ10-RRD, with Nord

require conf/machine/include/qcom-nord.inc

MACHINE_FEATURES += "efi pci"

KERNEL_DEVICETREE ?= " \
    qcom/nord-rrd.dtb \
    qcom/nord-ride-sx.dtb \
    "

MACHINE_ESSENTIAL_EXTRA_RRECOMMENDS += " \
    packagegroup-iq-10-rrd-firmware \
    packagegroup-iq-10-rrd-hexagon-dsp-binaries \
"

QCOM_CDT_FILE = ""
QCOM_BOOT_FILES_SUBDIR = ""
QCOM_PARTITION_FILES_SUBDIR ?= ""

QCOM_BOOT_FIRMWARE = ""
QCOM_CDT_FIRMWARE = ""

UBOOT_CONFIG = "nord"
```
